## components/smartbutton_battery_level/Kconfig
```kconfig
# -----------------------------------------------------------------------------------
# Copyright 2024, Gilles Zunino
# -----------------------------------------------------------------------------------

menu "SmartButton Battery Level"

    config SMARTBUTTON_BATTERY_LEVEL_ENABLE_DEBUG_LOG
        bool "Enable SmartButton battery level debug log"
        default n
        help
            Enable debug log messages for the SmartButton battery level measurement.

    config SMARTBUTTON_BATTERY_LEVEL_SAMPLE_COUNT
        int "Number of samples"
        default 10
        help
            Set the number of samples to average when measuring the SmartButton battery voltage.

    config SMARTBUTTON_BATTERY_LEVEL_SAMPLE_DELAY
        int "Sample delay (Ticks)"
        default 2
        help
            Set the delay between samples when measuring the SmartButton battery voltage.
            
    config SMARTBUTTON_BATTERY_LEVEL_SAMPLE_RETRY_COUNT
        int "Sample retry count"
        default 2
        help
            Set the number of retries when measuring the SmartButton battery voltage.

    config SMARTBUTTON_BATTERY_LEVEL_SAMPLE_RETRY_DELAY
        int "Sample retry delay (Ticks)"
        default 5
        help
            Set the delay between retries when measuring the SmartButton battery voltage.

endmenu
```

## main/Kconfig.projbuild
```kconfig
# -----------------------------------------------------------------------------------
# Copyright 2025, Gilles Zunino
# -----------------------------------------------------------------------------------

menu "Smarter Button"

    config SMARTERBUTTON_WIFI_SSID
        string "WiFi SSID"
        default ""
        help
            SSID (network name) to connect to.

    config SMARTERBUTTON_WIFI_PASSWORD
        string "WiFi Password"
        default ""
        help
            WiFi password (WPA/WPA2/WPA3) to use.

    config SMARTERBUTTON_WIFI_CONNECT_MAXIMUM_RETRY
        int "Maximum Connection Retries"
        default 5
        help
            Set the maximum number of retries when connecting / reconnecting to the Access Point.

endmenu
```

## sdkconfig.defaults
```kconfig
# -----------------------------------------------------------------------------------
# Copyright 2025, Gilles Zunino
# -----------------------------------------------------------------------------------

# Configure Flash Size = 4MB - Make ESPTOOL autodetect Flash Size
CONFIG_ESPTOOLPY_FLASHSIZE_4MB=y
CONFIG_ESPTOOLPY_FLASHSIZE="4MB"
CONFIG_ESPTOOLPY_HEADER_FLASHSIZE_UPDATE=y
```
